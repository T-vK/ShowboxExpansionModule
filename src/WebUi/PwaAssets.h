#pragma once
#include <Arduino.h>

static const char PWA_MANIFEST[] = R"MAN({
  "id": "/",
  "name": "ShowboxMod",
  "short_name": "ShowboxMod",
  "description": "Mackie Showbox mixer remote",
  "start_url": "/",
  "scope": "/",
  "display": "standalone",
  "display_override": ["standalone", "minimal-ui"],
  "prefer_related_applications": false,
  "categories": ["music", "utilities"],
  "orientation": "any",
  "background_color": "#0b0c10",
  "theme_color": "#0b0c10",
  "lang": "en",
  "icons": [
    {
      "src": "/icon-192.png",
      "sizes": "192x192",
      "type": "image/png",
      "purpose": "any"
    },
    {
      "src": "/icon-512.png",
      "sizes": "512x512",
      "type": "image/png",
      "purpose": "any"
    },
    {
      "src": "/icon-192.png",
      "sizes": "192x192",
      "type": "image/png",
      "purpose": "maskable"
    },
    {
      "src": "/icon-512.png",
      "sizes": "512x512",
      "type": "image/png",
      "purpose": "maskable"
    }
  ]
}
)MAN";

static const char PWA_SW[] = R"SJS(const CACHE = "showboxmod-v15";

self.addEventListener("install", (event) => {
  self.skipWaiting();
  event.waitUntil(
    caches.open(CACHE).then((cache) => cache.addAll(["/", "/manifest.webmanifest"]))
  );
});

self.addEventListener("activate", (event) => {
  event.waitUntil(
    caches.keys().then((keys) =>
      Promise.all(keys.filter((key) => key !== CACHE).map((key) => caches.delete(key)))
    ).then(() => self.clients.claim())
  );
});

// Read the whole body before handing it over: a transfer that dies mid-body
// (the BLE-coex radio stalls big HTTP responses partway) rejects here
// instead of silently delivering a broken asset.
async function fetchWhole(req) {
  const res = await fetch(req);
  if (!res || !res.ok) {
    return res;
  }
  const buf = await res.arrayBuffer();
  const headers = new Headers(res.headers);
  headers.delete("Content-Encoding");
  headers.delete("Content-Length");
  return new Response(buf, { status: res.status, statusText: res.statusText, headers });
}

self.addEventListener("fetch", (event) => {
  const req = event.request;
  if (req.method !== "GET") {
    return;
  }
  let url;
  try {
    url = new URL(req.url);
  } catch {
    return;
  }
  if (url.origin !== self.location.origin) {
    return;
  }
  const path = url.pathname;
  if (path.startsWith("/api/") || path === "/ws" || path.startsWith("/ws")) {
    return;
  }
  // Hashed build assets are immutable: cache-first, so repeat loads never
  // touch the radio. On a fetch that fails or dies mid-body, retry a few
  // times before giving up.
  if (path.startsWith("/assets/")) {
    event.respondWith((async () => {
      const hit = await caches.match(req);
      if (hit) {
        return hit;
      }
      let last = null;
      for (let i = 0; i < 4; i++) {
        try {
          const res = await fetchWhole(req);
          if (res && res.ok) {
            const copy = res.clone();
            caches.open(CACHE).then((cache) => cache.put(req, copy));
            return res;
          }
          last = res;
        } catch (err) {
          last = null;
        }
        await new Promise((r) => setTimeout(r, 700));
      }
      return last || fetch(req);
    })());
    return;
  }
  event.respondWith(
    fetch(req)
      .then((res) => {
        if (res.ok && (path === "/" || path.endsWith(".webmanifest") || path.endsWith(".png") || path.endsWith(".js"))) {
          const copy = res.clone();
          caches.open(CACHE).then((cache) => cache.put(req, copy));
        }
        return res;
      })
      .catch(() => caches.match(req).then((hit) => hit || caches.match("/")))
  );
});
)SJS";

static const uint8_t PWA_ICON_192[] PROGMEM = {
  0x89, 0x50, 0x4e, 0x47, 0x0d, 0x0a, 0x1a, 0x0a, 0x00, 0x00, 0x00, 0x0d, 0x49, 0x48, 0x44, 0x52,
  0x00, 0x00, 0x00, 0xc0, 0x00, 0x00, 0x00, 0xc0, 0x08, 0x02, 0x00, 0x00, 0x00, 0xdd, 0xbe, 0xfb,
  0x50, 0x00, 0x00, 0x02, 0x52, 0x49, 0x44, 0x41, 0x54, 0x78, 0xda, 0xed, 0xdd, 0x31, 0xae, 0x82,
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  0x00, 0x00, 0x00, 0x49, 0x45, 0x4e, 0x44, 0xae, 0x42, 0x60, 0x82,
};
static const size_t PWA_ICON_192_LEN = 651;

static const uint8_t PWA_ICON_512[] PROGMEM = {
  0x89, 0x50, 0x4e, 0x47, 0x0d, 0x0a, 0x1a, 0x0a, 0x00, 0x00, 0x00, 0x0d, 0x49, 0x48, 0x44, 0x52,
  0x00, 0x00, 0x02, 0x00, 0x00, 0x00, 0x02, 0x00, 0x08, 0x02, 0x00, 0x00, 0x00, 0x7b, 0x1a, 0x43,
  0xad, 0x00, 0x00, 0x0e, 0x47, 0x49, 0x44, 0x41, 0x54, 0x78, 0xda, 0xed, 0xdd, 0xb1, 0xad, 0xc2,
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  0x2d, 0xb9, 0x4d, 0xf7, 0x00, 0x00, 0x00, 0x00, 0x49, 0x45, 0x4e, 0x44, 0xae, 0x42, 0x60, 0x82,
};
static const size_t PWA_ICON_512_LEN = 3712;

static const uint8_t PWA_ICON_180[] PROGMEM = {
  0x89, 0x50, 0x4e, 0x47, 0x0d, 0x0a, 0x1a, 0x0a, 0x00, 0x00, 0x00, 0x0d, 0x49, 0x48, 0x44, 0x52,
  0x00, 0x00, 0x00, 0xb4, 0x00, 0x00, 0x00, 0xb4, 0x08, 0x02, 0x00, 0x00, 0x00, 0xb2, 0xaf, 0x91,
  0x65, 0x00, 0x00, 0x02, 0x1c, 0x49, 0x44, 0x41, 0x54, 0x78, 0xda, 0xed, 0xdc, 0xbd, 0x0d, 0x82,
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  0x44, 0xae, 0x42, 0x60, 0x82,
};
static const size_t PWA_ICON_180_LEN = 597;
